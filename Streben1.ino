#include<stdlib.h>
#include<TimerOne.h>

int data[500]={-77,-72,-71,-67,-64,-59,-54,-54,-57,-62,-67,-71,-77,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-25,-31};
int pointer=0, i, j, packet[10],a=0,byt[5]={0,0,0,0,0};
int temp[10];
void setup() {
  
  Timer1.initialize(20000); //Half Sec.
  Timer1.attachInterrupt(send_data);
  Serial.begin(115200);
}
int light=0;
void send_data(void)
{
//  byt=0;
  if(pointer==500)
    pointer=0;
  
  for(i=0;i<10;i++)
  {
    temp[i]=data[pointer++];    
  }
  packet[0]=temp[0];
  for(j=1;j<10;j++)
  {
    packet[j]=temp[j-1]-temp[j];
  }
  Serial.write(0x80);
  //Serial.println(byt);
  Serial.write(temp[0] & 0xFF);
  Serial.write(temp[0]>>8);
  for(i=0;i<22;i++)
    Serial.print(a);
  //Serial.println(byt);
  for(i=1;i<10;i++)
  {
    Serial.write(temp[i]);
    for(j=0;j<11;j++)
    {
      Serial.print(a);
    }
  }
   
}

void loop()
{
  if(light==1)
  {
    digitalWrite(13,LOW);
    light=0;
  }
  else
  {
    digitalWrite(13,HIGH);
    light=1;
  }
  delay(1000);
}
